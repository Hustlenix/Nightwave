## firmware/components/app_state/Kconfig
```kconfig
menu "Nightwave hardware"
choice NIGHTWAVE_BOARD
    prompt "Board profile (must match actual wiring)"
    default NIGHTWAVE_REFERENCE_BOARD
    config NIGHTWAVE_REFERENCE_BOARD
        bool "AI reference PCB: TFT and TCA9535 (unqualified hardware)"
    config NIGHTWAVE_LEGACY_BENCH
        bool "Legacy USB bench: OLED and direct GPIO buttons"
endchoice
endmenu
```

## firmware/sdkconfig.defaults
```kconfig
CONFIG_FREERTOS_HZ=1000
CONFIG_LOG_DEFAULT_LEVEL_INFO=y
CONFIG_COMPILER_CXX_EXCEPTIONS=n
CONFIG_COMPILER_CXX_RTTI=n
CONFIG_ESPTOOLPY_FLASHSIZE_16MB=y
CONFIG_SPIRAM=y
CONFIG_SPIRAM_MODE_OCT=y
CONFIG_SPIRAM_SPEED_80M=y
CONFIG_SPIRAM_BOOT_INIT=y
CONFIG_SPIRAM_USE_CAPS_ALLOC=y
CONFIG_FATFS_LFN_HEAP=y
CONFIG_FATFS_MAX_LFN=255
CONFIG_FATFS_API_ENCODING_UTF_8=y
```
